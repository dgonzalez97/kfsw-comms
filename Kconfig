## Kconfig
```kconfig
menu "K-FSW communications"

config KFSW_CSP
	bool "K-FSW Cubesat Space Protocol"
	select LIBCSP
	select CSP_USE_RTABLE
	help
	  Enable K-FSW's libcsp setup and router.

if KFSW_CSP

config KFSW_CSP_ADDRESS
	int "Local CSP node address"
	range 1 16383
	default 1
	help
	  CSP version 2 node address assigned to this K-FSW image.

config KFSW_CSP_HOSTNAME
	string "CSP hostname"
	default "kfsw"

config KFSW_CSP_MODEL
	string "CSP model"
	default BOARD_TARGET
	help
	  Model string reported to identity requests. Defaults to the board
	  target; set it to a product name if needed.

config KFSW_CSP_REVISION
	string "CSP revision"
	default "kfsw-dev"

config KFSW_CSP_ROUTE_TABLE
	string "Static CSP route table"
	default ""
	help
	  Optional libcsp-native route table loaded after all interfaces are
	  registered. The format is a comma-separated list of
	  "destination[/prefix-length] interface [via]" entries. An empty value
	  preserves the legacy direct 0/0 route through the first KISS/UART
	  interface. Multi-interface compositions must provide an explicit table.
	  The pinned libcsp parser accepts at most 99 characters.

config KFSW_CSP_KISS_UART
	bool "CSP KISS interface over a Zephyr UART"
	depends on SERIAL
	help
	  Register libcsp's maintained KISS interface over one or more dedicated
	  Zephyr UARTs. Existing compositions may select one UART with the
	  kfsw,csp-uart chosen property. Multi-interface compositions use children
	  of a kfsw,csp-kiss-uarts devicetree node; each child supplies a UART,
	  unique interface name, and optional interface address/prefix length.

config KFSW_CSP_UART_INTERRUPT_DRIVEN
	bool "Use interrupt-driven CSP UART receive"
	depends on KFSW_CSP_KISS_UART && UART_INTERRUPT_DRIVEN
	help
	  Feed received UART bytes from Zephyr's interrupt-driven API into
	  libcsp's maintained KISS decoder. Physical UART profiles should enable
	  this to avoid overruns in libcsp's polling Zephyr USART backend. Native
	  PTY profiles continue to use libcsp's USART integration directly.

config KFSW_CSP_UART_PEER_ADDRESS
	int "CSP node on the other end of the UART link"
	depends on KFSW_CSP_KISS_UART
	range 1 16383
	default 1
	help
	  Node pinged by `uart test`. Set it separately from the local address.

config KFSW_CSP_UART_CODEC
	bool "Packet codec on a KISS interface"
	depends on KFSW_CSP_KISS_UART
	help
	  Allow a module to protect packets on one named UART interface. A bounded
	  receive worker runs the codec outside interrupt context.

config KFSW_CSP_UART_CODEC_STACK_SIZE
	int "UART codec receive stack"
	depends on KFSW_CSP_UART_CODEC
	default 3072
	range 1024 8192

config KFSW_CSP_UART_CODEC_QUEUE_DEPTH
	int "Queued UART packets awaiting their codec"
	depends on KFSW_CSP_UART_CODEC
	default 4
	range 1 16

config KFSW_CSP_UART_CODEC_PRIORITY
	int "UART codec receive priority"
	depends on KFSW_CSP_UART_CODEC
	default 3
	range 1 15

config KFSW_CSP_CAN
	bool "CSP over CAN"
	depends on CAN
	help
	  Register a CAN controller as a CSP interface. libcsp splits packets
	  across CAN frames. The controller comes from the kfsw,csp-can chosen
	  node; on native_sim it can be a SocketCAN interface.

if KFSW_CSP_CAN

config KFSW_CSP_CAN_INTERFACE_NAME
	string "CAN interface name"
	default "CAN"
	help
	  Name libcsp knows this interface by, and what a route table entry
	  refers to. At most nine characters, which is the pinned text parser's
	  limit.

config KFSW_CSP_CAN_BITRATE
	int "CAN bitrate in bits per second"
	default 500000
	help
	  Both ends of a CAN bus must agree on this. Only 125000, 250000,
	  500000, 800000 and 1000000 are selectable at runtime; a build may
	  start at any of them.

config KFSW_CSP_CAN_PREFIX_LENGTH
	int "CAN interface address prefix length"
	default 14
	range 0 14
	help
	  Prefix length over the 14-bit CSP v2 node identifier. 14 addresses one
	  exact node; 0 makes this interface the default route.

endif # KFSW_CSP_CAN

config KFSW_CSP_CLOCK_RTC
	bool "Keep the time in the RTC instead of RAM"
	depends on RTC
	default y if RTC
	help
	  Keep the wall clock in the RTC named by the kfsw,rtc chosen node
	  instead of libcsp's RAM offset, so the time survives a software reset.
	  Surviving a power cycle needs VBAT.

config KFSW_CSP_CLOCK_FLOOR
	int "Earliest time that counts as set, in seconds since 1970"
	default 1577836800
	help
	  An RTC that was never set reads its hardware epoch, which is 2000 on
	  STM32, not zero. Times before this value are reported as unset. The
	  default is 2020-01-01.

config KFSW_CSP_ROUTER_STACK_SIZE
	int "CSP router thread stack size"
	default 2048

config KFSW_CSP_ROUTER_PRIORITY
	int "CSP router thread priority"
	default 0

endif # KFSW_CSP

endmenu
```

## dts/bindings/misc/kfsw,csp-kiss-uarts.yaml
```yaml
description: K-FSW CSP KISS interfaces backed by Zephyr UART devices

compatible: "kfsw,csp-kiss-uarts"

child-binding:
  description: One independently named CSP KISS/UART interface

  properties:
    uart:
      type: phandle
      required: true
      description: Zephyr UART device used by this KISS interface

    interface-name:
      type: string
      required: true
      description: Unique libcsp interface name (one to nine route-safe characters)

    address:
      type: int
      description: CSP address owned by this interface; defaults to KFSW_CSP_ADDRESS

    prefix-length:
      type: int
      default: 0
      description: CSP v2 subnet prefix length in the range 0 through 14
```
